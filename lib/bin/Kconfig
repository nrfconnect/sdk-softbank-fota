## lib/bin/Kconfig
```kconfig
#
# Copyright (c) 2025 Nordic Semiconductor ASA
#
# SPDX-License-Identifier: LicenseRef-Nordic-5-Clause
#

menu "Binary libraries"

rsource "sb_fota/Kconfig"

endmenu
```

## lib/bin/sb_fota/Kconfig
```kconfig
#
# Copyright (c) 2025 Nordic Semiconductor ASA
#
# SPDX-License-Identifier: LicenseRef-Nordic-5-Clause
#

menuconfig SB_FOTA
	bool "nRF91 modem FOTA library for SoftBank"
	depends on AT_MONITOR
	depends on AT_PARSER
	depends on FOTA_DOWNLOAD
	depends on HTTP_CLIENT
	depends on JSON_LIBRARY
	depends on MODEM_JWT
	depends on MODEM_INFO
	depends on NETWORKING
	depends on NET_SOCKETS
	depends on NET_SOCKETS_OFFLOAD
	depends on NRF_MODEM_LIB
	depends on PDN
	depends on PICOLIBC || NEWLIB_LIBC || EXTERNAL_LIBC

if SB_FOTA

config SB_FOTA_TLS_SECURITY_TAG
	int "Security tag for TLS"
	default 50
	help
	  Security tag to be used for TLS connections with the servers.

config SB_FOTA_JWT_SECURITY_TAG
	int "Security tag for JWT"
	default 50
	help
	  Security tag to be used for signing JWT tokens.

config SB_FOTA_AUTOINIT
	bool "Initialize the SoftBank FOTA library automatically"
	help
	  Initialize the SoftBank FOTA library automatically after the modem library is initialized.

choice SB_FOTA_CLIENT_ID
	prompt "Client ID format"
	default SB_FOTA_ID_UUID
	help
	  Select the Client identifier format to be used to communicate with nRF Cloud.

config SB_FOTA_ID_UUID
	bool "Device UUID"

config SB_FOTA_ID_IMEI
	bool "IMEI"

endchoice

config SB_FOTA_ID_PREFIX
	string "Prefix to be added to the Client ID"
	default ""
	help
	  Prefix to be added to the Client ID in communications with nRF Cloud. This combination is
	  used to identify the device, therefore the same identity must be used during provisioning.
	  This prefix is only added if either the IMEI or the UUID format is used. This
	  configuration will be ignored if the Client ID is changed at runtime.

config SB_FOTA_LOG
	bool "Link binary with logs"
	help
	  Links the application with the library version capable of emitting logs.
	  This increases the final size of the application.

module=SB_FOTA
module-dep=LOG
module-str=SoftBank FOTA library
source "${ZEPHYR_BASE}/subsys/logging/Kconfig.template.log_config"

endif # SB_FOTA
```

## west.yml
```yaml
# Copyright (c) 2025 Nordic Semiconductor ASA
# SPDX-License-Identifier: LicenseRef-Nordic-5-Clause

manifest:
  # self:
  #   west-commands: scripts/west-commands.yml

  remotes:
    - name: ncs
      url-base: https://github.com/nrfconnect
    - name: nRFCloud
      url-base: https://github.com/nRFCloud

  projects:
    - name: nrf
      remote: ncs
      repo-path: sdk-nrf
      revision: v2.8.0
      import: true
    - name: nrf_cloud_utils
      remote: nRFCloud
      repo-path: utils
      revision: 13378ebe0f7d7ad9da2678086eb19673b988c275
```
